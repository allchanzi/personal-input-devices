## config/boards/shields/sofle_right_test/Kconfig.defconfig
```kconfig
# Copyright (c) 2026
# SPDX-License-Identifier: MIT

if SHIELD_SOFLE_RIGHT_TEST

config ZMK_KEYBOARD_NAME
    default "SofleRTest"

endif
```

## config/boards/shields/sofle_right_test/Kconfig.shield
```kconfig
# Copyright (c) 2026
# SPDX-License-Identifier: MIT

config SHIELD_SOFLE_RIGHT_TEST
    def_bool $(shields_list_contains,sofle_right_test)
```

## config/boards/shields/sofleltest/Kconfig.defconfig
```kconfig
# Copyright (c) 2026
# SPDX-License-Identifier: MIT

if SHIELD_SOFLELTEST

config ZMK_KEYBOARD_NAME
    default "SofleLTest"

endif
```

## config/boards/shields/sofleltest/Kconfig.shield
```kconfig
# Copyright (c) 2026
# SPDX-License-Identifier: MIT

config SHIELD_SOFLELTEST
    def_bool $(shields_list_contains,sofleltest)
```

## config/boards/shields/soflertest/Kconfig.defconfig
```kconfig
# Copyright (c) 2026
# SPDX-License-Identifier: MIT

if SHIELD_SOFLERTEST

config ZMK_KEYBOARD_NAME
    default "SofleRTest"

endif
```

## config/boards/shields/soflertest/Kconfig.shield
```kconfig
# Copyright (c) 2026
# SPDX-License-Identifier: MIT

config SHIELD_SOFLERTEST
    def_bool $(shields_list_contains,soflertest)
```
